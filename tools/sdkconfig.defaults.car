## tools/sdkconfig.defaults.car
```kconfig
# 本项目的小车构建预设。
CONFIG_BOARD_TYPE_INTELLIGENT_CAR=y
CONFIG_OLED_SSD1306_128X64=y
# 灵矽公开接入入口；连接凭据由服务端下发，不写入仓库。
CONFIG_OTA_URL="https://xrobo.qiniuapi.com/v1/ota/"
```

## tools/sdkconfig.defaults.qebabe
```kconfig
# 工程构建预设；不修改上游默认配置和板级行为。
CONFIG_BOARD_TYPE_QEBABE_XIAOCHE=y
CONFIG_OLED_SSD1306_128X64=y
```
